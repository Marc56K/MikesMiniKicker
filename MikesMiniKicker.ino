#include <PCM.h>

#define BLUE_LED_PIN 13

const int lightPins[] = { 10, 12 };
const int goalPins[] { 2, 3 };

const unsigned char goalSound[] PROGMEM = {
 134, 141, 161, 173, 0, 255, 173, 255, 0, 0, 96, 255,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 132 
};

const unsigned char winSound[] PROGMEM = {
 141, 131, 123, 111, 108, 133, 157, 139, 119, 101, 107, 139,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 150
};

const byte segments[10] = { 0b00111111, 0b00001001, 0b01011110, 0b01011011, 0b01101001, 0b01110011, 0b01110111, 0b00011001, 0b01111111, 0b01111011 };

class Player
{ 
public:
  Player()
  {
  }

  void setup(int dataPin, int latchPin, int clockPin)
  {
    _dataPin = dataPin;
    _latchPin = latchPin;
    _clockPin = clockPin;
    _goalDetected = false;

    _score = 0;
    
    pinMode(_latchPin, OUTPUT);
    pinMode(_dataPin, OUTPUT);  
    pinMode(_clockPin, OUTPUT);

    updateScoreDisplay(true);
  }

  void flickerLights(const int count, const int wait)
  {
      // flicker lights
      digitalWrite(BLUE_LED_PIN, LOW);
      for (int i = 0; i < count; i++)
      {
        updateScoreDisplay(i % 2 == 0);

        digitalWrite(lightPins[0], i % 2 == 0 ? HIGH : LOW);
        digitalWrite(lightPins[1], i % 2 == 0 ? LOW : HIGH);

        delay(wait);
      }

      // switch all lights on
      digitalWrite(BLUE_LED_PIN, HIGH);
      for (int i = 0; i < 2; i++)
      {
        digitalWrite(lightPins[i], HIGH);
      }
  }

  bool update()
  {
    bool goal = _goalDetected;
    if (goal)
    {
      _score++;
    }

    bool gameOver = _score > 9;

    updateScoreDisplay(true);

    if (goal)
    {
      if (gameOver)
      {
        startPlayback(winSound, sizeof(winSound));
        flickerLights(40, 25);
      }
      else
      {
        startPlayback(goalSound, sizeof(goalSound));
        flickerLights(10, 50);
      }
      
      delay(1000);
    }

    if (goal)
    {
      _goalDetected = false;
    }

    return gameOver;
  }

  void setGoal()
  {
    _goalDetected = true;
  }

  void reset()
  {
    _score = 0;
    updateScoreDisplay(true);
    _goalDetected = false;
  }

private:
  void updateScoreDisplay(const bool decimalPoint)
  {
    byte value = segments[_score % 10];
    if (decimalPoint)
    {
      bitSet(value, 7);
    }
    digitalWrite(_latchPin, LOW);
    shiftOut(_dataPin, _clockPin, LSBFIRST, value);
    digitalWrite(_latchPin, HIGH);
  }

private:
  int _dataPin;
  int _latchPin;
  int _clockPin;
  volatile bool _goalDetected;

  int _score;
};

Player players[2];

void interrupt0()
{
  players[0].setGoal();
}

void interrupt1()
{
  players[1].setGoal();
}

void setup() 
{
  // enable segment displays
  pinMode(A0, OUTPUT);
  digitalWrite(A0, HIGH);
  
  players[0].setup(8, 9, 4);
  players[1].setup(5, 6, 7);

  // enable blue led
  pinMode(BLUE_LED_PIN, OUTPUT);
  digitalWrite(BLUE_LED_PIN, HIGH);

  for (int i = 0; i < 2; i++)
  {
    // setup lights
    pinMode(lightPins[i], OUTPUT);
    digitalWrite(lightPins[i], HIGH);

    // setup goals
    pinMode(goalPins[i], INPUT);
  }

  // register goal callbacks
  attachInterrupt(digitalPinToInterrupt(goalPins[0]), interrupt0, CHANGE); 
  attachInterrupt(digitalPinToInterrupt(goalPins[1]), interrupt1, CHANGE);
}

void loop() 
{
  bool gameOver = false;
  for (int i = 0; i < 2; i++)
  {
    gameOver = gameOver || players[i].update();
  }

  if (gameOver)
  {
    delay(1000);
    for (int i = 0; i < 2; i++)
    {
      players[i].reset();
    }
  }
}
